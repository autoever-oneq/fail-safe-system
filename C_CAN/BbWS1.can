/*@!Encoding:65001*/
includes
{
  
}

variables
{
    /* Structs and Enums */
  /* Common Enums */
  enum MachineState {
    NORMAL = 0,
    CAUTION = 1,
    EMERGENCY = 2
  };
  
  
  /* Contrived Malfunction */
  enum MalfunctionState {
    MALFUNCTION_NONFAULT,
    MALFUNCTION_TRANSCEIVER_ERR,
    MALFUNCTION_LOGIC_ERR
  };
  
  
  /* Redundancy */
  enum Sensor {
    SENSOR_0 = 0,
    SENSOR_1 = 1
  };
  
  
  enum Actuator {
    ACTUATOR_0 = 0,
    ACTUATOR_1 = 1
  };
  
  
  enum CanBus {
    BOTH = 0,
    CAN_1 = 1,
    CAN_2 = 2,
    NEITHER = 3
  };
  
  
  /* ECU Messages Enums */
  enum MechanicalDistributionLevel {
    MD_LEVEL_0 = 0,
    MD_LEVEL_1 = 1,
    MD_LEVEL_2 = 2
  };
  
  
  enum RegerativeBrakingLevel {
    RB_LEVEL_0 = 0,
    RB_LEVEL_1 = 1,
    RB_LEVEL_2 = 2
  };
  
  
  enum PedalState {
    PEDAL_INACTIVE = 0,
    PEDAL_ACTIVE = 1
  };
  
  
  enum AbsActive {
    ABS_INACTIVE = 0,
    ABS_ACTIVE = 1
  };
  
  
  enum ErrorSig {
    SIGNAL_FAIL = 0,
    SIGNAL_SUCCESS = 1
  };
  
  
  enum ConnectionState {
    DISCONNECTED = 0,
    CONNECTED = 1
  };
  
  
  enum FailInfo {
    CAN_BUSY = 0,
    SENSOR_ERR = 1,
    ACTUATOR_ERR = 2
  };
  
  
  enum Channel {
    CHANNEL1 = 1,
    CHANNEL2 = 2,
    CHANNEL3 = 3,
    CHANNEL4 = 4,
    CHANNEL5 = 5,
    CHANNEL6 = 6
  };
  
  
  /* Redundancy Structs */
  struct PrimaryEcu {
    enum Sensor sensor;
    enum Actuator actuator;
  };
  
  
  /* ECU Message Structs */
  struct MechanicalBrakeStatus {
    int mechanicalBrakeDistribution;
    enum MechanicalDistributionLevel mechanicalDistributionLevel;
  };
  
  
  struct RegenerativeBrakingStatus {
    int regenerativeBrakingDistribution;
    enum RegerativeBrakingLevel regenerativeBrakingLevel;
  };
  
  
  struct PowertrainStatus {
    int batterySoC;
    int batterySoH;
    long vehicleSpeed;
    long targetSpeed;
  };
  
  
  struct BbWSStatus {
    byte isPrimary;
    enum MachineState state;
    int msgCount;
    enum CanBus primaryBus;
  };
  
  
  struct BrakeCommand {
    int activeBrakePressure;
    enum ConnectionState sensorState;
    enum PedalState pedalState;
  };
  
  
  struct BrakePedalState {
    enum PedalState brakePedalActive;
    int brakePedalPostion;
  };
  
  
  struct BrakeFeedback {
    int feedbackPressure;
    int wheelSpeed;
    enum AbsActive feedbackAbsActive;
    enum ErrorSig errorSig;
  };
  
  
  struct FailStatus {
    int failCount;
    enum FailInfo failInfo;
  };
  
  
   /* Constant */
  const int RATIO_10MS    = 1;
  const int RATIO_20MS    = 2;
  const int RATIO_50MS    = 5;
  const int RATIO_100MS   = 10;
  const int RATIO_1000MS  = 100;
  
  const int BRAKE_PRESSURE_LOW_LIMIT = 0;
  const int BRAKE_PRESSURE_HIGH_LIMIT = 16000;
  const int BRAKE_DEFAULT_TEMPERATURE = 20;
  const double BRAKE_FRICTION = 0.4;
  const double BRAKE_CROSS_SECTION = 0.004;
  const int BRAKE_PERIOD_MS = 10;
  const int BRAKE_COUNT = 4;
  
  const double TYRE_RADIUS_CM = 40;
  
  const double SPEED_SCALING_KPH = 100;
  const double KM_TO_M_RATIO = 1000;
  const double M_TO_CM_RATIO = 100;
  const double HOUR_TO_SECONDS = 3600;
  const double MINUITE_TO_SECOND = 60;
  const double SECOND_TO_10MS = 100;
  const double TENMS_TO_SECOND = 0.01;
  const double KPH_TO_CMP10MS = KM_TO_M_RATIO * M_TO_CM_RATIO / SPEED_SCALING_KPH / HOUR_TO_SECONDS / SECOND_TO_10MS;
  
  const double BAR_Npm2 = 100000;
  const double SPEED_DELTA_PER_BAR_CMP10MS = BAR_Npm2 * BRAKE_CROSS_SECTION * BRAKE_FRICTION * M_TO_CM_RATIO * TENMS_TO_SECOND;
  
  const int VEHICLE_WEIGHT_KG = 2000;
  
  // SENSOR-DEPENDANT
  const enum Sensor SENSOR_NUM = SENSOR_1;
  
  /* Common */
  msTimer g_10msTimer;
  msTimer g_resetTimer;
  int g_timerCounter = 0;
  
  
  /* Contrived Malfunction */
  enum MalfunctionState g_malfunctionState = MALFUNCTION_NONFAULT;
  
  /* Redundancy */
  struct PrimaryEcu g_primaryEcu = {
    sensor = SENSOR_0,
    actuator = ACTUATOR_0 
  };
  
  
  /* MechanicalBrakeStatus */
  struct MechanicalBrakeStatus g_mechanicalBrakeStatus = {
    mechanicalBrakeDistribution = 0,
    mechanicalDistributionLevel = MD_LEVEL_0
  };
  
  struct RegenerativeBrakingStatus g_regenerativeBrakingStatus = {
    regenerativeBrakingDistribution = 0,
    regenerativeBrakingLevel = RB_LEVEL_0
  };
  
  
  struct PowertrainStatus g_powertrainStatus = {
    batterySoC = 0,
    batterySoH = 0,
    vehicleSpeed = 0,
    targetSpeed = 0
  };
  
  
  /* BbWS_Status */
  struct BbWSStatus g_bbwsStatus = {
    isPrimary = 0,
    state = NORMAL,
    msgCount = 0,
    primaryBus = BOTH
  };
  
  /* BrakeCommand */
  struct BrakeCommand g_brakeCommand = {
    activeBrakePressure = BRAKE_PRESSURE_LOW_LIMIT,
    sensorState = CONNECTED,
    pedalState = PEDAL_INACTIVE
  };
  
  
  struct BrakePedalState g_brakePedalState = {
    brakePedalActive = PEDAL_INACTIVE,
    brakePedalPostion = 0
  };
  
  
  struct FailStatus g_failStatus = {
    failCount = 0,
    failInfo = CAN_BUSY
  };
  
  
  struct BrakeFeedback g_brakeFeedback = {
    feedbackPressure = 0,
    wheelSpeed = 0,
    feedbackAbsActive = ABS_INACTIVE,
    errorSig = SIGNAL_SUCCESS
  };
  
}



on start {
  setTimerCyclic(g_10msTimer, 10); 
}

on timer g_resetTimer {
  HardReset();
}

on timer g_10msTimer {
  if (g_timerCounter % RATIO_10MS == 0) {
    AppSchedule10ms();
  }
  
  if (g_timerCounter % RATIO_20MS == 0) {
    AppSchedule20ms();
  }
  
  if (g_timerCounter % RATIO_50MS == 0) {
    AppSchedule50ms();
  }
  
  if (g_timerCounter % RATIO_100MS == 0) {
    AppSchedule100ms();
  }
  
  if (g_timerCounter % RATIO_1000MS == 0) {
    AppSchedule1000ms();
    g_timerCounter = 0;
  }
  
  g_timerCounter++;
}

on message DriveModeStatus {
  if (g_malfunctionState == MALFUNCTION_TRANSCEIVER_ERR) {
    return;
  }
  
  ModifyMachineStatus((enum MachineState)this.ModeState);
}

on message SetBrake {
  if (g_malfunctionState == MALFUNCTION_TRANSCEIVER_ERR) {
    return;
  }
  
  g_primaryEcu.sensor = (enum Sensor)this.SetPrimarySensorBrake;
  g_primaryEcu.actuator = (enum Actuator)this.SetPrimaryActuatorBrake;
  if (g_primaryEcu.sensor == SENSOR_NUM) {
    g_bbwsStatus.isPrimary = 1;
    write("[+] BbWS1 is Primary");
  }
}

on message CommandResetBrake {
  if (g_malfunctionState == MALFUNCTION_TRANSCEIVER_ERR) {
    return;
  }
  
  if (this.HardResetBbWS1 == 1) {
    // sleep 3s for reset
    write("[+] BbWS0 Hard Reset");
    g_malfunctionState = MALFUNCTION_TRANSCEIVER_ERR;
    setTimer(g_resetTimer, 3000);
  }
}

on message CANHealthyCheck {
  if (g_malfunctionState == MALFUNCTION_TRANSCEIVER_ERR) {
    return;
  }
  
  g_bbwsStatus.primaryBus = (enum CanBus)((this.CAN1Healthy * 2) + (this.CAN2Healthy * 1));
}

on message MechanicalBrakeStatus {
  if (g_malfunctionState == MALFUNCTION_TRANSCEIVER_ERR) {
    return;
  }
  
  g_mechanicalBrakeStatus.mechanicalBrakeDistribution = this.MechanicalBrakeDistribution;
  g_mechanicalBrakeStatus.mechanicalDistributionLevel = (enum MechanicalDistributionLevel)this.MechanicalDistributionLevel;
  CalculateBrakePressure();
}

on message RegenerativeBrakeStatus {
  if (g_malfunctionState == MALFUNCTION_TRANSCEIVER_ERR) {
    return;
  }
  
  g_regenerativeBrakingStatus.regenerativeBrakingDistribution = this.RegenerativeBrakingDistribution;
  g_regenerativeBrakingStatus.regenerativeBrakingLevel = (enum RegerativeBrakingLevel)this.RegenerativeBrakingLevel;
}

on message PowertrainStatus {
  if (g_malfunctionState == MALFUNCTION_TRANSCEIVER_ERR) {
    return;
  }
  
  g_powertrainStatus.batterySoC = this.BatterySOC;
  g_powertrainStatus.batterySoH = this.BatterySOH;
  g_powertrainStatus.vehicleSpeed = this.VehicleSpeed;
  g_powertrainStatus.targetSpeed = this.TargetVehicleSpeed;
}

on message BrakeFeedback0 {
  if (g_malfunctionState == MALFUNCTION_TRANSCEIVER_ERR) {
    return;
  }
}

on message BrakeFeedback1 {
  if (g_malfunctionState == MALFUNCTION_TRANSCEIVER_ERR) {
    return;
  }
}

on message WheelStatus0 {
  if (g_malfunctionState == MALFUNCTION_TRANSCEIVER_ERR) {
    return;
  }
}

on message WheelStatus1 {
  if (g_malfunctionState == MALFUNCTION_TRANSCEIVER_ERR) {
    return;
  }
  
}


void TransmitBrakeSensorStatus() {
  message BbWS1_Status statusMsg;
  statusMsg.EcuIsPrimary.phys = g_bbwsStatus.isPrimary;
  statusMsg.BbWS_MachineState.phys = g_bbwsStatus.state;
  statusMsg.EcuStatusMsgCount.phys = g_bbwsStatus.msgCount++;
  statusMsg.PrimaryBus.phys = g_bbwsStatus.primaryBus;
  
  Transmit(statusMsg);
}

void TransmitBrakeCommand() {
  message BrakeCommand1 commandMsg;
  commandMsg.ActiveBrakePressure.phys = g_brakeCommand.activeBrakePressure;
  commandMsg.BrakeConnectionState.phys = g_brakeCommand.sensorState;
  commandMsg.BrakePedalActive.phys = g_brakeCommand.pedalState;
  
  Transmit(commandMsg);
}

void TransmitBrakeFailStatus() {
  message BrakeSensor1FailStatus failStatusMsg;
  failStatusMsg.BbWS_FailCount.phys = g_failStatus.failCount;
  failStatusMsg.BbWS_FailInfo.phys = g_failStatus.failInfo;
  
  Transmit(failStatusMsg);
}

void TransmitBrakePedalState() {
  message BrakePedalState1 pedalMsg;
  pedalMsg.BrakePedalActive.phys = g_brakePedalState.brakePedalActive;
  pedalMsg.BrakePedalPosition.phys = g_brakePedalState.brakePedalPostion;
  
  Transmit(pedalMsg);
}

void AppSchedule10ms() {
  TransmitBrakeSensorStatus();
  TransmitBrakeCommand();
}

void AppSchedule20ms() {
  TransmitBrakePedalState();
  TransmitBrakeFailStatus();
}

void AppSchedule50ms() {}

void AppSchedule100ms() {}

void AppSchedule1000ms() {}

void ModifyMachineStatus(enum MachineState state) {
  g_bbwsStatus.state  = state;
  if (g_bbwsStatus.state == EMERGENCY) {
    //todo!: Emergency Process
  }
}

void Transmit(message * msg) {
  if (g_malfunctionState == MALFUNCTION_TRANSCEIVER_ERR) {
    return;
  }
  
  switch (g_bbwsStatus.primaryBus) {
    case BOTH:
      msg.can = CHANNEL1;
      output(msg);
      msg.can = CHANNEL2;
      output(msg);
      return;
    case CAN_1:
      msg.can = CHANNEL1;
      break;
    case CAN_2:
      msg.can = CHANNEL2;
      break;
    default:
      return;
  }
  
  output(msg);
}

void HardReset() {
  /* Common */
  g_timerCounter = 0;
  
  
  /* BbWA_Status */
  g_bbwsStatus.isPrimary = 0;
  g_primaryEcu.sensor = SENSOR_0;
  g_bbwsStatus.state = NORMAL;
  g_bbwsStatus.msgCount = 0;
  
  
  /* BrakeFeedback */
  g_brakeFeedback.feedbackPressure = 0;
  g_brakeFeedback.wheelSpeed = 0;
  g_brakeFeedback.feedbackAbsActive = ABS_INACTIVE;
  g_brakeFeedback.errorSig = SIGNAL_SUCCESS;
  
  
  /* FailStatus */
  g_failStatus.failCount = 0;
  g_failStatus.failInfo = CAN_BUSY;
  g_malfunctionState = MALFUNCTION_NONFAULT;
}

void CalculateBrakePressure() {
  double a, Fb, vt, v0;
  double P;
  
  if (g_malfunctionState == MALFUNCTION_LOGIC_ERR) {
    g_failStatus.failCount++;
    g_failStatus.failInfo = SENSOR_ERR;
  }
  
  vt = g_powertrainStatus.targetSpeed * KPH_TO_CMP10MS;
  v0 = g_powertrainStatus.vehicleSpeed * KPH_TO_CMP10MS;
  
  if (vt >= v0) {
    g_brakeCommand.activeBrakePressure = 0;
    g_brakeCommand.pedalState = PEDAL_ACTIVE;
    g_brakeCommand.sensorState = CONNECTED;
    return;
  }
  
  a = (v0 - vt);
  Fb = VEHICLE_WEIGHT_KG * a;
  P = Fb / (BRAKE_CROSS_SECTION * BRAKE_FRICTION * BRAKE_COUNT) / BAR_Npm2;
  P *= 100; // 100x scaling
  
  g_brakeCommand.activeBrakePressure = (int)P;
  g_brakeCommand.pedalState = PEDAL_ACTIVE;
  g_brakeCommand.sensorState = CONNECTED;
  
  write("P: %lf, a: %lf, Fb: %lf", P, a, Fb);
}


on key 'm' {
  g_malfunctionState = MALFUNCTION_TRANSCEIVER_ERR; 
  setTimer(g_resetTimer, 3000);
}