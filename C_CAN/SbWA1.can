/*@!Encoding:65001*/
includes
{
  
}

variables
{
  msTimer SbWA1_T;
  timer Reset_T;
  byte TimerCounter=0;
  byte CommandLost=0;
  
  // VCU's
  byte ecuisPrimary=0;  
  byte SbWS_Machinstate =0;
  word ecuStatusMsgCnt =0;
  byte primaryBus =5;
  byte is_off =0 ;
  
  
  byte SbWA_FailCount;
  byte SbWA_FailInfo;
  
  byte modeState; // vehicle mode 0(normal) 1(caution) 2(emergency)
  byte HardResetSig; // 1 to reset
  byte isHealthyBus; // 0(none),1,2,3(both)
  
  
  
  // Self Data
  float steerFeedbackAngle;
  
  
  // Actuator info
  byte PrimaryAct; // 0 or 1
  float SteerFeedback;
  
  
  
  
  enum MalfunctionState {
    MALFUNCTION_NONFAULT,
    MALFUNCTION_TRANSCEIVER_ERR,
    MALFUNCTION_LOGIC_ERR
  };
  
  byte error=MALFUNCTION_NONFAULT;
  
}

on start{
 setTimerCyclic(SbWA1_T,10); 
  
}

on timer Reset_T{
  is_off = 0;
  
  error=MALFUNCTION_NONFAULT;
  
  ecuisPrimary=0;  // start with Act 0 Primary
  SbWS_Machinstate =0;
  ecuStatusMsgCnt =0;
  primaryBus =0;
  steerFeedbackAngle=0;
  SbWA_FailCount=0;
  SbWA_FailInfo=0;
  
  CommandLost =0;
}

on timer SbWA1_T{
  if(!is_off){ // 10ms Task
    TimerCounter++;
    CommandLost++;
    if(CommandLost >=3){
      is_off=1;
      setTimer(Reset_T,3);
      // Didn't reciecve any Control messages from Both Sensor 3 Times -> reboot
    }
    TransmitStatus();
  
    if(TimerCounter==2){  //20ms Task
      TransmitSteerFeedback();
      TransmitSteerActFailStatus();
      TimerCounter=0;
     }
  }
}

on message SetSteer{
  if(error==MALFUNCTION_LOGIC_ERR)
    return;
  
  if(error==MALFUNCTION_TRANSCEIVER_ERR)
    return;
  
  ecuisPrimary = this.SetPrimaryActuatorSteer ? 1 : 0;
}

on message CommandResetSteer{
  if(error==MALFUNCTION_TRANSCEIVER_ERR)
    return;
  if(this.HardResetSbWA0){
    HardReset();
  }
}

on message SteerCommand0{
  ActuateSteer(this.SteerAngle);
  CommandLost =0;
}

on message SteerCommand1{
  ActuateSteer(this.SteerAngle);
  CommandLost =0;   
}



on message CANHealthyCheck{
  if(error==MALFUNCTION_TRANSCEIVER_ERR)
    return;
  
 if(!this.CAN1Healthy){
   if(!this.CAN2Healthy){
      primaryBus = 0; 
    }
    else{
      primaryBus =2;   
    }
 }
 else{
   if(!this.CAN2Healthy){
      primaryBus = 1; 
    }
    else
     primaryBus = 3;    
 }
}


void ActuateSteer(long CmdAngle){
  if(error==MALFUNCTION_LOGIC_ERR){
    SbWA_FailCount++;
    SbWA_FailInfo = MALFUNCTION_LOGIC_ERR;
    return;
  }
  steerFeedbackAngle= CmdAngle;
  
}

void HardReset(){
 is_off =1;
 setTimer(Reset_T,3); 
}



void Transmit(message * msg) {
  if(error==MALFUNCTION_TRANSCEIVER_ERR)
    return;
  
  if(primaryBus==3) {
    msg.can=1;
    output(msg);
    msg.can=2;
    output(msg);
  }
  else
  {
   msg.can=primaryBus;
    output(msg);
  }
}

void TransmitStatus(){
  message SbWA1_Status status;
  status.EcuIsPrimary.phys = ecuisPrimary;
  status.SbWA_MachineState.phys =SbWS_Machinstate;
  status.EcuStatusMsgCount.phys = ecuStatusMsgCnt;
  status.PrimaryBus.phys = primaryBus;
  Transmit(status);
  ecuStatusMsgCnt++;
}

void TransmitSteerFeedback(){
  if( ecuisPrimary){
  message SteerFeedback0 feedback;
  feedback.SteerFeedbackAngle.phys = steerFeedbackAngle;
  Transmit(feedback);
  }
}

void TransmitSteerActFailStatus(){
  message SteerActuator0FailStatus Failstatus;
  Failstatus.SbWA_FailCount = SbWA_FailCount;
  Failstatus.SbWA_FailInfo = SbWA_FailInfo;
  Transmit(Failstatus);  
}

