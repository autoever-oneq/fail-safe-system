/*@!Encoding:65001*/
includes
{
  
}

variables
{
  msTimer SbWS_timer;
  timer Reset_T;
  byte is_off=0;
  
  // VCU's
  byte ecuisPrimary=0;
  byte SbWS_Machinstate =0;
  word ecuStatusMsgCnt =0;
  byte primaryBus =1;
  byte SbWS_FailCount;
  byte SbWS_FailInfo;
  
  byte modeState; // vehicle mode 0(normal) 1(caution) 2(emergency)
  byte setPrimaryAct; // 0 or 1 to select 
  byte isHealthyBus; // 0(none),1,2,3(both)
  
  int wheelSpeed=0;
  
  // Self Data
  byte isPrimary=0;
  byte MachineState=0;
  
  long SteerDriverAngle;
  long SteerDriverAngle_before=0;
  int SteerDriverTorque=0;
  
  int SteerAngle=0;
  int SteerAngleBefore=0;
  int SteerWheelTorque=0;
  byte SteerConnectionState=0;
  int carspeed=0;
  
  byte error;
  
  
  // Actuator info
  byte PrimaryAct; // 0 or 1
  int SteerFeedback;
  
  
 
}

on start
{
  setTimerCyclic(SbWS_timer,10);
}

on timer Reset_T{
  is_off=0;
  ecuisPrimary =0;
  SbWS_Machinstate =0;
  ecuStatusMsgCnt =0;
  primaryBus =0;
  SbWS_FailCount=0;
  SbWS_FailInfo=0;
}

on message DriveModeStatus{
  modeState = this.ModeState;
    if (modeState == 0) {

    } 
    else if (modeState == 1) { 
    
    } 
    else if (modeState == 2) {
    
    } 
    else {
    
    }
}

on message SetSteer{
  if(this.SetPrimarySensorSteer){
    isPrimary=1;
    SteerConnectionState=1;
    //for S1
  }
  else{
    isPrimary=0;
    SteerConnectionState=1;
   //for S0
  }
  
}

on message PowertrainStatus{
 carspeed=this.VehicleSpeed; 
}

on message SbWA0_Status{
  if(this.EcuIsPrimary == 0){
   PrimaryAct=1; 
  } 
}

on message SbWA1_Status{
  if(this.EcuIsPrimary == 0){
   PrimaryAct=0; 
  } 
}




on message CommandResetSteer{
  if(this.HardResetSbWS1){
      is_off = 1;
    setTimer(Reset_T, 3);
 }
}

on message CANHealthyCheck{
 if(!this.CAN1Healthy){
   if(!this.CAN2Healthy){
      primaryBus = 0; 
    }
    else{
      primaryBus =2;   
    }
 }
 else{
     primaryBus = 1;    
   
 }
}


on message SteerFeedback1{
    if (PrimaryAct == 0){
        if(SteerAngle != this.SteerFeedbackAngle){
            SbWS_FailCount++;
    }
    }
  
  }


on timer SbWS_timer
{
  if(!is_off){
  SteerAngle = CalcAngleWithRestore(SteerAngle, SteerDriverAngle, carspeed, SteerDriverAngle_before, 1);
  SteerDriverAngle=SteerAngle*16;
  SteerDriverAngle_before = SteerDriverAngle;

  TransmitSteerCommand1();
  TransmitDriverStatus1();
  TransmitSensor1FailStatus();
  TransmitStatus();
  }
}



int CalcAngleWithRestore(int theta_bf, long steer, int speed, long driver_angle_before, int restore_rate) {
    int theta;
    theta = steer / 16;

    // 입력 변화가 없으면 복원 동작 수행
    if (steer == driver_angle_before) {
        if (theta > 0) {
            theta -= restore_rate;  // 양수 각도 감소
            if (theta < 0) theta = 0;  // 0으로 복원
        } else if (theta < 0) {
            theta += restore_rate;  // 음수 각도 증가
            if (theta > 0) theta = 0;  // 0으로 복원
        }
    }

    // 속도에 따른 각도 제한
   if (speed >= 40 && speed < 80) {
        // 변화량이 10도를 넘지 않도록 제한
        if (abs(theta - theta_bf) > 10) {
            theta = (theta > theta_bf) ? theta_bf + 1 : theta_bf - 1;
        }
        if (abs(theta) > 20) {
            theta = (theta < 0) ? -20 : 20;
        }
    } else if (speed >= 80) {
        // 변화량이 1도를 넘지 않도록 제한
        if (abs(theta - theta_bf) > 1) {
            theta = (theta > theta_bf) ? theta_bf + 1 : theta_bf - 1;
        }
        if (abs(theta) > 10) {
            theta = (theta < 0) ? -10 : 10;
        }
    }

    return theta;
}

void Transmit(message * msg) {
  if(primaryBus==3) {
    msg.can=1;
    output(msg);
    msg.can=2;
    output(msg);
  }
  else
  {
   msg.can=primaryBus;
    output(msg);
  }
}

void TransmitStatus(){
  message SbWS1_Status status;
  status.EcuIsPrimary.phys=isPrimary;
  status.SbWS_MachineState.phys=MachineState;
  status.EcuStatusMsgCount.phys=ecuStatusMsgCnt;
  status.PrimaryBus.phys=primaryBus;
  Transmit(status);
  ecuStatusMsgCnt++;
}

  
 void TransmitDriverStatus1(){
   message SteerDriverState0 DriverState;
   DriverState.SteerDriverAngle.phys = SteerDriverAngle;
   DriverState.SteerDriverTorque.phys =SteerDriverTorque;
   
   Transmit(DriverState);
 }
 
 void TransmitSensor1FailStatus(){
   message SteerSensor0FailStatus FailStatus;
   FailStatus.SbWS_FailCount.phys=SbWS_FailCount;
  FailStatus.SbWS_FailInfo.phys = SbWS_FailInfo;   
   Transmit(FailStatus);
 } 

void TransmitSteerCommand1(){
  if(ecuisPrimary){
  message SteerCommand0 cmd;
  cmd.SteerAngle.phys = SteerAngle;
  cmd.SteerWheelTorque.phys=SteerWheelTorque;
  cmd.SteerConnectionState.phys = SteerConnectionState;
  Transmit(cmd);
  }
}
on message 0x500{
 SbWS_FailCount ++;
}