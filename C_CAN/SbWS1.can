/*@!Encoding:65001*/
includes
{
  
}

variables
{
  msTimer SbWS_timer;
  timer Reset_T;
  byte is_off=0;
  byte pSen = 0;
  
  
  // VCU's
  byte SbWS_Machinstate =0;
  word ecuStatusMsgCnt =0;
  byte primaryBus =5;
  byte SbWS_FailCount;
  byte SbWS_FailInfo;
  
  byte modeState; // vehicle mode 0(normal) 1(caution) 2(emergency)
  byte setPrimaryAct; // 0 or 1 to select 
  byte isHealthyBus; // 0(none),1,2,3(both)
  
  int wheelSpeed=0;
  
  // Self Data
  
  enum HealthyCan{
    NONE,
    BUS1,
    BUS2,
    BOTH
  };
  
  byte isPrimary=0;
  byte MachineState=0;
  
  long SteerDriverAngle=0;
  int SteerDriverTorque=0; // Unused but can init with delta theta?
  
  
  long _100xSteerAngle=0;  //updated Angle;
  long _100xSteerAngleBefore=0; //currernt Angle
  long targetAngle =0; 
  
  long restoreAngle; // target delta_restoreAngle
  
  
  
  
  
  int SteerWheelTorque=0; // Unused but can init with delta theta?
  
  byte SteerConnectionState=0;
  int carspeed=0;
  
  byte isHandleOn=1;
  
  enum MalfunctionState {
  MALFUNCTION_NONFAULT,
  MALFUNCTION_TRANSCEIVER_ERR,
  MALFUNCTION_LOGIC_ERR
  };
  
  
  
  // Actuator info
  byte PrimaryAct; // 0 or 1
  int SteerFeedback;
  
  
  
  
 
}

on start
{
  setTimerCyclic(SbWS_timer,10);
  @sysvar::Chassis::DriverSteerAngle =SteerDriverAngle;
}

on timer Reset_T{
  is_off=0;
  isPrimary =0;
  MachineState=MALFUNCTION_NONFAULT;
  SbWS_Machinstate =0;
  ecuStatusMsgCnt =0;
  primaryBus =1;
  SbWS_FailCount=0;
  SbWS_FailInfo=0;
}

on message DriveModeStatus{
  modeState = this.ModeState;
    if (modeState == 0) {
        //Normal
    } 
    else if (modeState == 1) { 
        //caution
    } 
    else if (modeState == 2) {
        // Emergency
    } 
    else {
        // 
    }
}



on message SetSteer{
   if(MachineState == MALFUNCTION_TRANSCEIVER_ERR)
     return;
    isPrimary = (this.SetPrimarySensorSteer) ? 1 : 0 ;
    pSen = isPrimary ? 1 : 0;
    SteerConnectionState=1;
}

on message PowertrainStatus{
   if(MachineState ==MALFUNCTION_TRANSCEIVER_ERR)
     return;
 carspeed=this.VehicleSpeed; 
   
}

on message SbWA0_Status{
   if(MachineState == MALFUNCTION_TRANSCEIVER_ERR)
  if(this.EcuIsPrimary == 0){
   PrimaryAct=1; 
   }
}

on message SbWA1_Status{
   if(MachineState == MALFUNCTION_TRANSCEIVER_ERR)
     return;
     
  if(this.EcuIsPrimary == 0){
   PrimaryAct=0; 
  }

}



on message CommandResetSteer{
   if(MachineState == !MALFUNCTION_TRANSCEIVER_ERR)
    return;
  if(this.HardResetSbWS1){
    write("[+] SbWS1 Hard Reset");
    MachineState = MALFUNCTION_TRANSCEIVER_ERR;
    HardReset();
 }
   
}


on message CANHealthyCheck{
   if(MachineState == !MALFUNCTION_TRANSCEIVER_ERR){
      if(this.CAN1Healthy){
        primaryBus =BUS1;   
        if(this.CAN2Healthy){
            primaryBus = BOTH; 
          }
        }
    else{
      primaryBus =BUS2; 
      if(!this.CAN2Healthy)
        primaryBus = NONE;
      }
   }
}

on message SteerFeedback0{
  if(MachineState == !MALFUNCTION_TRANSCEIVER_ERR){
    
    if (PrimaryAct == 0){
        if(_100xSteerAngle != this.SteerFeedbackAngle){
          
    }
    }
  }
  }

 //    if(isHandleOn){ // check Val of Steer switchPannel
on sysvar Chassis::DriverSteerAngle{
      
  if(isHandleOn){
    SteerDriverAngle= @sysvar::Chassis::DriverSteerAngle;
    
    targetAngle = (SteerDriverAngle*100)/15;
    
    if(carspeed>=80){
      if (abs(targetAngle) > 1000) {
        targetAngle= (targetAngle < 0) ? -1000 : 1000; 
      } 
    }
  else if(carspeed <80 && carspeed >=40){
    if (abs(targetAngle) > 2000) {
        targetAngle= (targetAngle < 0) ? -2000 : 2000; 
      } 
    }
    else{
      if (abs(targetAngle) > 6000) {
        targetAngle= (targetAngle < 0) ? -6000 : 6000; 
      } 
    }
}
}

//   }
  
  
on timer SbWS_timer
{
    if(isPrimary)
      @sysvar::Chassis::WheelAngle=_100xSteerAngle;
    else
      _100xSteerAngle=@sysvar::Chassis::WheelAngle;
    
    if(!is_off){
      if(isHandleOn){
        SteerDriverAngle= @sysvar::Chassis::DriverSteerAngle;
        reCtrl();
        CalcAngle();
      }

    else{
      if(abs(SteerDriverAngle) >abs( (_100xSteerAngle * 15)/100 )){
        SteerDriverAngle -= (SteerDriverAngle > 0) ? 10 : -10;
        if(abs (SteerDriverAngle) - abs( (_100xSteerAngle * 15)/100 ) <=10 ) {
          SteerDriverAngle = (_100xSteerAngle * 15) /100 ;
        }
      }   //SteerWheel is restored linearly (10), then if it match with Real Steer, restore Naturally
      else{
      restoreAngle = CalcRestoreAngle(_100xSteerAngle, carspeed);
        _100xSteerAngle += restoreAngle;
        SteerDriverAngle = (_100xSteerAngle * 15) /100;
        _100xSteerAngleBefore=_100xSteerAngle;
        targetAngle=0;
      
      }
      @sysvar::Chassis::DriverSteerAngle =SteerDriverAngle;
      }
    
    TransmitSteerCommand1(); // 액츄에이터에 연산 결과(조향각) 송신
    TransmitDriverStatus1();
    TransmitSensor1FailStatus();
    TransmitStatus();
  }
}


long CalcRestoreAngle(long _100xtheta, int speed) {
    float k;                      // 복원 강도 계수
    float max_restore = 0.2;       // 20ms당 최대 변화량
    float alpha = 0.5;             // 복원 강도 지수
    float theta; // 각도를 1도 단위로 변환
    float delta_theta;
    theta = _100xtheta / 100.0;
    k = calc_K(); // 속도에 따른 복원 강도 계산

    // 정지 상태에서는 복원 없음
    if (speed <= 0) return 0;

    // 복원 각도 변화량 계산 (로그 스케일을 사용하여 천천히 복원)
    delta_theta = k * mypow(myabs(theta), alpha);

    // 최대 변화량 제한
    if (delta_theta > max_restore) {
        delta_theta = max_restore;
    }

    // 부호에 따라 복원 각도 조정
    if (theta > 0) {
        delta_theta = -delta_theta; // 양수일 경우 복원 각도는 음수로
    }
    else {
        delta_theta = delta_theta;  // 음수일 경우 복원 각도는 양수로0
    }

    // 0에 가까워질 경우 0으로 고정
    if (myabs(theta) < delta_theta) {
        delta_theta = -theta; // 남은 각도만큼만 복원
    }
    return (long)(delta_theta * 100.0); // 결과를 다시 _100 단위로 변환
  
}

float myexp(float x) {
  float result;
  float term;
  float tolerance;
  int n;
    // 간단한 근사를 위해 첫 번째 항만 사용
    if (x > 2.0 || x < -2.0) {
        // 큰 값일 경우에는 직접 계산을 하지 않고 빠르게 근사값 반환
        return 1.0 + x + (x * x) / 2.0;  // x^1 / 1! + x^2 / 2! 정도로 간단히 근사
    }

    // 테일러 급수의 첫 몇 항만 사용하여 근사
    result = 1.0;
    term = x;
    tolerance = 1e-6; // 오차 허용 범위

    for (n = 2; myabs(term) > tolerance; n++) {
        result += term;
        term *= x / n;  // x^n / n!
    }
    return result;
}

float mypow(float base, float exponent) {
    int i;
    if (base < 0 && (exponent - (int)exponent) != 0) { //negative return 0
        return 0.0;
    }
    if (base == 0 && exponent <= 0) { // zerobase return 0
        return 0.0;
    }
    if (exponent == 0) {
        return 1.0;
    }
    if (exponent < 0) {
        return 1.0 / mypow(base, -exponent);
    }

    if ((exponent - (int)exponent) == 0) { // 정수 지수 확인
        float result = 1.0;
        for (i = 0; i < (int)exponent; i++) {
            result *= base;
        }
        return result;
    }
    // 비정수 지수 처리: base^exponent = exp(exponent * ln(base))

    return myexp(exponent * logApprox(base)); // 로그 근사값으로 사용
}

float logApprox(float x) {
    float estimate;
    float diff;
    float tolerance;
    if (x <= 0) {
        return 0.0;
    }

    // 로그 근사값 계산을 위한 초기 값
    estimate = x - 1;  // 초기 추정 값
    tolerance = 0.001;  // 허용 오차
    diff = 1.0;

    // 뉴턴-랩슨 방법으로 근사 계산
    while (myabs(diff) > tolerance) {
        diff = (x - myexp(estimate)) / x;  // 로그 근사를 위한 차이 계산
        estimate = estimate + diff;
    }
    return estimate;
}


float myabs(float x) {
    if (x == 0)
        return 0.0;
    else
        return x= (x > 0) ? x : x * (-1);
}


float calc_K() {
    float k;
    k= 0.0005 * carspeed + 0.01;

    //  {k| 0.01<= k <= 0.07}
    if (k > 0.07) k = 0.07;
    if (k < 0.01) k = 0.01;
    return k;
}

void CalcAngle() {
  float theta_bf;
  float theta;
  
  theta_bf=_100xSteerAngleBefore;
    if (carspeed >= 40 && carspeed < 80) {
        if(abs(targetAngle)>2000)
            targetAngle = abs(targetAngle)>2000 ? 2000 : -2000;
      
        // 20ms당 변화량이 0.2도를 넘지 않도록 제한
        if (abs(targetAngle - theta_bf) > 20) {
            theta = (targetAngle > theta_bf) ? theta_bf + 15 : theta_bf - 15;
        }     
        
        else{
         theta = targetAngle; 
        }
        
    } 
    else if (carspeed >= 80) {
        if(abs(targetAngle)>1000)
            targetAngle = abs(targetAngle)>1000 ? 1000 : -1000;
      
        // 20ms당 변화량이 0.1도를 넘지 않도록 제한
        if (abs(targetAngle - theta_bf) > 10) {
            theta = (targetAngle > theta_bf) ? theta_bf + 7: theta_bf - 7;
        }
        else{
         theta = targetAngle; 
        }
    }
    
      else{
         theta = targetAngle; 
        }
    _100xSteerAngle=theta;
    _100xSteerAngleBefore=_100xSteerAngle;
}


void HardReset(){
 is_off =1;
 setTimer(Reset_T,3); 
}

void reCtrl(){ // Called when Take SteerWheel During Restoring Steer
 targetAngle = (SteerDriverAngle*100)/15;
    
    if(carspeed>=80){
      if (abs(targetAngle) > 1000) {
        targetAngle= (targetAngle < 0) ? -1000 : 1000; 
      } 
    }
  else if(carspeed <80 && carspeed >=40){
    if (abs(targetAngle) > 2000) {
        targetAngle= (targetAngle < 0) ? -2000 : 2000; 
      } 
    }
    else{
      if (abs(targetAngle) > 6000) {
        targetAngle= (targetAngle < 0) ? -6000 : 6000; 
      } 
    } 
  
}


void Transmit(message * msg) {
  if(MachineState == MALFUNCTION_TRANSCEIVER_ERR)
    return;
  if(primaryBus==3) {
      msg.can=5;
      output(msg);
      msg.can=6;
      output(msg);
      }
  else
  {
    msg.can=5;
    output(msg);
  }
}




void TransmitStatus(){
  message SbWS1_Status status;
  status.EcuIsPrimary.phys=isPrimary;
  status.SbWS_MachineState.phys=MachineState;
  status.EcuStatusMsgCount.phys=ecuStatusMsgCnt;
  status.PrimaryBus.phys=primaryBus;
  Transmit(status);
  if(!MALFUNCTION_TRANSCEIVER_ERR)
    ecuStatusMsgCnt++;
}

  
 void TransmitDriverStatus1(){
   message SteerDriverState1 DriverState;
   DriverState.SteerDriverAngle.phys = SteerDriverAngle;
   DriverState.SteerDriverTorque.phys =SteerDriverTorque;
   
   Transmit(DriverState);
   
 }
 
 void TransmitSensor1FailStatus(){
   message SteerSensor1FailStatus FailStatus;
   FailStatus.SbWS_FailCount.phys=SbWS_FailCount;
  FailStatus.SbWS_FailInfo.phys = SbWS_FailInfo;   
   Transmit(FailStatus);
 } 

void TransmitSteerCommand1(){
  message SteerCommand1 cmd;
  cmd.SteerAngle.phys = _100xSteerAngle;
  cmd.SteerWheelTorque.phys=SteerWheelTorque;
  cmd.SteerConnectionState.phys = SteerConnectionState;
  write("ECU : %d, Primary : %d, Current Speed : %d, Steer Angle : %d, Driver Angle : %d \n" ,1,pSen, carspeed,_100xSteerAngle,SteerDriverAngle);
  Transmit(cmd);
  
}


on key 'l' {
 isHandleOn = !isHandleOn;
}
on key 'w'{
  carspeed+=10;
  write("speed : %d",carspeed);
}

on key 's'{
  carspeed-=10;
    write("speed : %d",carspeed);
}

on key 'c'{
    isPrimary = !isPrimary;  
    pSen = isPrimary ? 1 : 0; 
}