/*@!Encoding:65001*/
includes
{
  
}

variables
{
  msTimer SbWA0_T;
  timer Reset_T;
  byte TimerCounter=0;
  byte CommandLost=0;
  
  // VCU's
  byte ecuisPrimary=0;  // start with Act 0 Primary
  byte SbWS_Machinstate =0;
  word ecuStatusMsgCnt =0;
  byte primaryBus =0;
  byte is_off =0 ;
  byte isPrimary=1;
  
  
  byte SbWA_FailCount;
  byte SbWA_FailInfo;
  
  byte modeState; // vehicle mode 0(normal) 1(caution) 2(emergency)
  byte HardResetSig; // 1 to reset
  byte isHealthyBus; // 0(none),1,2,3(both)
  enum primarySen{
    SEN0,
    SEN1
  };
  byte pSen;
  
  // Self Data
  float steerFeedbackAngle;
  
  
  // Actuator info
  byte PrimaryAct; // 0 or 1
  float SteerFeedback;
  
  
  
  
  enum MalfunctionState {
    MALFUNCTION_NONFAULT,
    MALFUNCTION_TRANSCEIVER_ERR,
    MALFUNCTION_LOGIC_ERR
  };
 enum HealthyCan{
    BOTH=0,
    BUS1,
    BUS2,
    NONE
  };
  
  byte error=MALFUNCTION_NONFAULT;
  
}

on start{
 setTimerCyclic(SbWA0_T,10); 
  
}

on message DriveModeStatus{
  modeState = this.ModeState;
    if (modeState == 0) {
        //Normal
    } 
    else if (modeState == 1) { 
        //caution
    } 
    else if (modeState == 2) {
        // Emergency
    } 
    else {
        // 
    }
}
on timer Reset_T{
  HardReset();
}

on timer SbWA0_T{
  if(!is_off){ // 10ms Task
    TimerCounter++;
    
    TransmitStatus();
  
    if(TimerCounter==2){  //20ms Task
      TransmitSteerFeedback();
      TransmitSteerActFailStatus();
      TimerCounter=0;
     }
  }
}

on message SbWS0_Status{
  if(error == MALFUNCTION_TRANSCEIVER_ERR)
    return;
  
  pSen = this.EcuIsPrimary ? 0 : 1;
}

on message SbWS1_Status{
  if(error == MALFUNCTION_TRANSCEIVER_ERR)
    return;
  
  pSen = this.EcuIsPrimary ? 1 : 0;
}

on message SetSteer{
  if(error == MALFUNCTION_TRANSCEIVER_ERR)
    return;
  
  isPrimary = this.SetPrimaryActuatorSteer ? 0: 1 ;
}

on message CommandResetSteer{
  if(error==MALFUNCTION_TRANSCEIVER_ERR)
    return;
  
  if(this.HardResetSbWA0){
    write("[+] SbWA0 Hard Reset");
    error = MALFUNCTION_TRANSCEIVER_ERR;
    is_off =1;
    setTimer(Reset_T,3); 
  }
}

on message SteerCommand0{
  if(error == MALFUNCTION_TRANSCEIVER_ERR)
    return;
  
  if(pSen == 1)
    return;
  ActuateSteer(this.SteerAngle);
  CommandLost =0;
}

on message SteerCommand1{
  if(error == MALFUNCTION_TRANSCEIVER_ERR)
    return;
  
  if(pSen == 0)
    return;
  ActuateSteer(this.SteerAngle);
  CommandLost =0;   
}

on message CANHealthyCheck{
   if(error == !MALFUNCTION_TRANSCEIVER_ERR){
     primaryBus = ((this.CAN1Healthy * 2) + (this.CAN2Healthy * 1));
   }
}

void HardReset(){
  is_off = 0;
  error=MALFUNCTION_NONFAULT;
  isPrimary=0;
  SbWS_Machinstate =0;
  ecuStatusMsgCnt =0;
  primaryBus =0;
  steerFeedbackAngle=0;
  SbWA_FailCount=0;
  SbWA_FailInfo=0;
  
  CommandLost =0;
}

void ActuateSteer(long CmdAngle){
  if(error==MALFUNCTION_LOGIC_ERR){
    SbWA_FailCount++;
    SbWA_FailInfo = MALFUNCTION_LOGIC_ERR;
    return;
  }
  steerFeedbackAngle= CmdAngle;
  
}


void Transmit(message * msg) {
  if(error == MALFUNCTION_TRANSCEIVER_ERR)
    return;
  if(primaryBus == NONE)
    return;
  if(primaryBus==BOTH) {
      msg.can=1;
      output(msg);
      msg.can=2;
      output(msg);
      }
  else
  {
    msg.can=primaryBus;
    output(msg);
  }
}

void TransmitStatus(){
  message SbWA0_Status status;
  status.EcuIsPrimary.phys = isPrimary;
  status.SbWA_MachineState.phys =modeState;
  status.EcuStatusMsgCount.phys = ecuStatusMsgCnt;
  status.PrimaryBus.phys = primaryBus;
  Transmit(status);
  ecuStatusMsgCnt++;
}

void TransmitSteerFeedback(){
  message SteerFeedback0 feedback;
  feedback.SteerFeedbackAngle.phys = steerFeedbackAngle;
  Transmit(feedback);

}

void TransmitSteerActFailStatus(){
  message SteerActuator0FailStatus Failstatus;
  Failstatus.SbWA_FailCount = SbWA_FailCount;
  Failstatus.SbWA_FailInfo = SbWA_FailInfo;
  Transmit(Failstatus);  
}

on key '7' {
  error = MALFUNCTION_TRANSCEIVER_ERR;
  setTimer(Reset_T, 3);
}