/*@!Encoding:65001*/
includes {
  
}

variables {
  /* Structs and Enums */
  /* Common Enums */
  enum MachineState {
    NORMAL = 0,
    CAUTION = 1,
    EMERGENCY = 2
  };
  
  
  /* Contrived Malfunction */
  enum MalfunctionState {
    MALFUNCTION_NONFAULT,
    MALFUNCTION_TRANSCEIVER_ERR,
    MALFUNCTION_LOGIC_ERR
  };
  
  
  /* Redundancy */
  enum Sensor {
    SENSOR_0 = 0,
    SENSOR_1 = 1
  };
  
  
  enum Actuator {
    ACTUATOR_0 = 0,
    ACTUATOR_1 = 1
  };
  
  
  enum CanBus {
    BOTH = 0,
    CAN_1 = 1,
    CAN_2 = 2,
    NEITHER = 3
  };
  
  
  /* ECU Messages Enums */
  enum AbsActive {
    ABS_INACTIVE = 0,
    ABS_ACTIVE = 1
  };
  
  
  enum ErrorSig {
    SIGNAL_FAIL = 0,
    SIGNAL_SUCCESS = 1
  };
  
  
  enum ConnectionState {
    DISCONNECTED = 0,
    CONNECTED = 1
  };
  
  
  enum RegerativeBrakingLevel {
    RB_LEVEL_0 = 0,
    RB_LEVEL_1 = 1,
    RB_LEVEL_2 = 2
  };
  
  
  enum PedalState {
    PEDAL_INACTIVE = 0,
    PEDAL_ACTIVE = 1
  };
  
  
  enum FailInfo {
    CAN_BUSY = 0,
    SENSOR_ERR = 1,
    ACTUATOR_ERR = 2
  };
  
  
  enum Channel {
    CHANNEL1 = 1,
    CHANNEL2 = 2,
    CHANNEL3 = 3,
    CHANNEL4 = 4,
    CHANNEL5 = 5,
    CHANNEL6 = 6
  };
  
  
  /* Redundancy Structs */
  struct PrimaryEcu {
    enum Sensor sensor;
    enum Actuator actuator;
  };
  
  
  /* ECU Message Structs */
  struct BbWAStatus {
    byte isPrimary;
    enum MachineState state;
    int msgCount;
    enum CanBus primaryBus;
  };
  
  
  struct BrakeCommand {
    int activeBrakePressure;
    enum ConnectionState sensorState;
    enum PedalState pedalState;
  };
  
  
  struct BrakeFeedback {
    int feedbackPressure;
    int wheelSpeed;
    enum AbsActive feedbackAbsActive;
    enum ErrorSig errorSig;
  };
  
  
  struct FailStatus {
    int failCount;
    enum FailInfo failInfo;
  };
  
  struct AbsFeedback {
    int absPulse;
    int brakeTemperature;
  };
  
  struct RegenerativeBrakingStatus {
    int regenerativeBrakingDistribution;
    enum RegerativeBrakingLevel regenerativeBrakingLevel;
  };
  
  struct PowertrainStatus {
    int batterySoC;
    int batterySoH;
    long vehicleSpeed;
    long targetSpeed;
  };
  
  
  /* Constant */
  const int RATIO_10MS    = 1;
  const int RATIO_20MS    = 2;
  const int RATIO_50MS    = 5;
  const int RATIO_100MS   = 10;
  const int RATIO_1000MS  = 100;
  
  const int BRAKE_PRESSURE_LOW_LIMIT = 40;
  const int BRAKE_PRESSURE_HIGH_LIMIT = 160;
  const int BRAKE_DEFAULT_TEMPERATURE = 20;
  const double BRAKE_FRICTION = 0.4;
  const double BRAKE_CROSS_SECTION = 0.004;
  const int BRAKE_PERIOD_MS = 10;
  const int BRAKE_COUNT = 4;
  
  const double TYRE_RADIUS_CM = 40;
  
  const double SPEED_SCALING_KPH = 100;
  const double KM_TO_M_RATIO = 1000;
  const double M_TO_CM_RATIO = 100;
  const double HOUR_TO_SECONDS = 3600;
  const double MINUITE_TO_SECOND = 60;
  const double SECOND_TO_10MS = 100;
  const double TENMS_TO_SECOND = 0.01;
  const double KPH_TO_CMP10MS = KM_TO_M_RATIO * M_TO_CM_RATIO / SPEED_SCALING_KPH / HOUR_TO_SECONDS / SECOND_TO_10MS;
  
  const double BAR_Npm2 = 100000;
  const double SPEED_DELTA_PER_BAR_CMP10MS = BAR_Npm2 * BRAKE_CROSS_SECTION * BRAKE_FRICTION * M_TO_CM_RATIO * TENMS_TO_SECOND;
  
  const int VEHICLE_WEIGHT_KG = 2000;
  
  const enum Actuator ACTUATOR_NUM = ACTUATOR_1;
  
  /* Common */
  msTimer g_10msTimer;
  msTimer g_resetTimer;
  int g_timerCounter = 0;
  
  
  /* Contrived Malfunction */
  enum MalfunctionState g_malfunctionState = MALFUNCTION_NONFAULT;
  
  
  /* Redundancy */
  struct PrimaryEcu g_primaryEcu = {
    sensor = SENSOR_0,
    actuator = ACTUATOR_0 
  };
  
  
  struct RegenerativeBrakingStatus g_regenerativeBrakingStatus = {
    regenerativeBrakingDistribution = 0,
    regenerativeBrakingLevel = RB_LEVEL_0
  };
  
  struct PowertrainStatus g_powertrainStatus = {
    batterySoC = 0,
    batterySoH = 0,
    vehicleSpeed = 0,
    targetSpeed = 0
  };
  
  /* BbWA_Status */
  struct BbWAStatus g_bbwaStatus = {
    isPrimary = 0,
    state = NORMAL,
    msgCount = 0,
    primaryBus = BOTH
  };
  
  
  /* BrakeCommand */
  struct BrakeCommand g_brakeCommand = {
    activeBrakePressure = BRAKE_PRESSURE_LOW_LIMIT,
    sensorState = CONNECTED,
    pedalState = PEDAL_INACTIVE
  };
  
  
  /* BrakeFeedback */
  struct BrakeFeedback g_brakeFeedback = {
    feedbackPressure = 0,
    wheelSpeed = 0,
    feedbackAbsActive = ABS_INACTIVE,
    errorSig = SIGNAL_SUCCESS
  };
  
  
  /* FailStatus */
  struct FailStatus g_failStatus = {
    failCount = 0,
    failInfo = CAN_BUSY
  };
  
  
  /* AbsFeedback */
  struct AbsFeedback g_absFeedback = {
    absPulse = 0,
    brakeTemperature = BRAKE_DEFAULT_TEMPERATURE
  };
  
  double g_speed_cmp10ms = 0;
}



on start {
  setTimerCyclic(g_10msTimer, 10);
}

on timer g_resetTimer {
  HardReset();
}

on timer g_10msTimer {
  if (g_timerCounter % RATIO_10MS == 0) {
    AppSchedule10ms();
  }
  
  if (g_timerCounter % RATIO_20MS == 0) {
    AppSchedule20ms();
  }
  
  if (g_timerCounter % RATIO_50MS == 0) {
    AppSchedule50ms();
  }
  
  if (g_timerCounter % RATIO_100MS == 0) {
    AppSchedule100ms();
  }
  
  if (g_timerCounter % RATIO_1000MS == 0) {
    AppSchedule1000ms();
    g_timerCounter = 0;
  }
  
  g_timerCounter++;
}

on message DriveModeStatus {
  if (g_malfunctionState == MALFUNCTION_TRANSCEIVER_ERR) {
    return;
  }
  
  ModifyMachineStatus((enum MachineState)this.ModeState);
}

on message SetBrake {
  if (g_malfunctionState == MALFUNCTION_TRANSCEIVER_ERR) {
    return;
  }
  
  g_primaryEcu.sensor = (enum Sensor)this.SetPrimarySensorBrake;
  g_primaryEcu.actuator = (enum Actuator)this.SetPrimaryActuatorBrake;
  if (g_primaryEcu.actuator == ACTUATOR_NUM) {
    g_bbwaStatus.isPrimary = 1;
    write("[+] BbWA1 is Primary");
  }
}

on message CommandResetBrake {
  if (g_malfunctionState == MALFUNCTION_TRANSCEIVER_ERR) {
    return;
  }
  
  if (this.HardResetBbWA1 == 1) {
    // sleep 3s for reset
    write("[+] BbWA1 Hard Reset");
    g_malfunctionState = MALFUNCTION_TRANSCEIVER_ERR;
    setTimer(g_resetTimer, 3000);
  }
}

on message CANHealthyCheck {
  if (g_malfunctionState == MALFUNCTION_TRANSCEIVER_ERR) {
    return;
  }
  
  g_bbwaStatus.primaryBus = (enum CanBus)((this.CAN1Healthy * 2) + (this.CAN2Healthy * 1));
}

on message RegenerativeBrakeStatus {
  if (g_malfunctionState == MALFUNCTION_TRANSCEIVER_ERR) {
    return;
  }
  
  g_regenerativeBrakingStatus.regenerativeBrakingDistribution = this.RegenerativeBrakingDistribution;
  g_regenerativeBrakingStatus.regenerativeBrakingLevel = (enum RegerativeBrakingLevel)this.RegenerativeBrakingLevel;
}

on message PowertrainStatus {
  if (g_malfunctionState == MALFUNCTION_TRANSCEIVER_ERR) {
    return;
  }
  
  g_powertrainStatus.batterySoC = this.BatterySOC;
  g_powertrainStatus.batterySoH = this.BatterySOH;
  g_powertrainStatus.vehicleSpeed = this.VehicleSpeed;
  g_powertrainStatus.targetSpeed = this.TargetVehicleSpeed;
}

on message BbWS0_Status {
  if (g_malfunctionState == MALFUNCTION_TRANSCEIVER_ERR) {
    return;
  }
  
  if (g_bbwaStatus.state == EMERGENCY) {
    return;
  }
  
  if (g_primaryEcu.sensor == SENSOR_1) {
    return;
  }
  
  if (this.PrimaryBus != this.can) {
    return;
  }
}

on message BbWS1_Status {
  if (g_malfunctionState == MALFUNCTION_TRANSCEIVER_ERR) {
    return;
  }
  
  if (g_bbwaStatus.state == EMERGENCY) {
    return;
  }
  
  if (g_primaryEcu.sensor == SENSOR_0) {
    return;
  }
  
  if (this.PrimaryBus != this.can) {
    return;
  }
}

on message BrakePedalState0 {
  if (g_malfunctionState == MALFUNCTION_TRANSCEIVER_ERR) {
    return;
  }
  
  if (g_bbwaStatus.state == EMERGENCY) {
    return;
  }
}

on message BrakePedalState1 {
  if (g_malfunctionState == MALFUNCTION_TRANSCEIVER_ERR) {
    return;
  }
  
  if (g_bbwaStatus.state == EMERGENCY) {
    return;
  }
}

on message BrakeCommand0 {
  if (g_malfunctionState == MALFUNCTION_TRANSCEIVER_ERR) {
    return;
  }
  
  if (g_bbwaStatus.state == EMERGENCY) {
    return;
  }
  
  if (g_primaryEcu.sensor == SENSOR_1) {
   return;
  }
  
  g_brakeCommand.activeBrakePressure = this.ActiveBrakePressure;
  g_brakeCommand.sensorState = (enum ConnectionState)this.BrakeConnectionState;
  g_brakeCommand.pedalState = (enum PedalState)this.BrakePedalActive;
  
  if (this.BrakePedalActive == PEDAL_ACTIVE) {
    ActuateBrake();
  }
}

on message BrakeCommand1 {
  if (g_malfunctionState == MALFUNCTION_TRANSCEIVER_ERR) {
    return;
  }
  
  if (g_bbwaStatus.state == EMERGENCY) {
    return;
  }
  
  if (g_primaryEcu.sensor == SENSOR_0) {
   return;
  }
  
  g_brakeCommand.activeBrakePressure = this.ActiveBrakePressure;
  g_brakeCommand.sensorState = (enum ConnectionState)this.BrakeConnectionState;
  g_brakeCommand.pedalState = (enum PedalState)this.BrakePedalActive;
  
  if (this.BrakePedalActive == PEDAL_ACTIVE) {
    ActuateBrake();
  }
}

on message AbsFeedback {
  if (g_malfunctionState == MALFUNCTION_TRANSCEIVER_ERR) {
    return;
  
  }
  g_absFeedback.absPulse = this.AbsPulse;
  g_absFeedback.brakeTemperature = this.BrakeTemperature;
}

void TransmitBrakeActuatorStatus() {
  message BbWA1_Status statusMsg;
  
  statusMsg.EcuIsPrimary.phys = g_bbwaStatus.isPrimary;
  statusMsg.BbWA_MachineState.phys = g_bbwaStatus.state;
  statusMsg.EcuStatusMsgCount.phys = g_bbwaStatus.msgCount++;
  statusMsg.PrimaryBus.phys = g_bbwaStatus.primaryBus;
  
  Transmit(statusMsg);
}

void TransmitBrakeFeedback() {
  message BrakeFeedback1 feedbackMsg;
  feedbackMsg.BrakeErrorSig.phys = g_brakeFeedback.errorSig;
  feedbackMsg.BrakeFeedbackABSActive.phys = g_brakeFeedback.feedbackAbsActive;
  feedbackMsg.BrakeFeedbackPressure.phys = g_brakeFeedback.feedbackPressure;
  feedbackMsg.WheelSpeed.phys = g_brakeFeedback.wheelSpeed;
  
  Transmit(feedbackMsg);
}

void TransmitBrakeFailStatus() {
  message BrakeActuator1FailStatus failStatusMsg;
  failStatusMsg.BbWA_FailCount.phys = g_failStatus.failCount;
  failStatusMsg.BbWA_FailInfo.phys = g_failStatus.failInfo;
  
  Transmit(failStatusMsg);
}

void TransmitWheelSpeed() {
  message WheelStatus1 wheelStatus;
  wheelStatus.WheelSpeed.phys = g_brakeFeedback.wheelSpeed;
  
  Transmit(wheelStatus);
}

void AppSchedule10ms() {
  TransmitBrakeActuatorStatus();
  TransmitBrakeFeedback();
}

void AppSchedule20ms() {
  TransmitBrakeFailStatus();
}

void AppSchedule50ms() {}

void AppSchedule100ms() {
  TransmitWheelSpeed();
}

void AppSchedule1000ms() {}

void ModifyMachineStatus(enum MachineState state) {
  g_bbwaStatus.state = state;
  
  if (g_bbwaStatus.state == EMERGENCY) {
    g_brakeCommand.activeBrakePressure = 2000;
    g_brakeCommand.pedalState = PEDAL_ACTIVE;
    ActuateBrake();
  }
}

void Transmit(message * msg) {
  if (g_malfunctionState == MALFUNCTION_TRANSCEIVER_ERR) {
    return;
  }
  
  switch (g_bbwaStatus.primaryBus) {
    case BOTH:
      msg.can = CHANNEL1;
      output(msg);
      msg.can = CHANNEL2;
      output(msg);
      return;
    case CAN_1:
      msg.can = CHANNEL1;
      break;
    case CAN_2:
      msg.can = CHANNEL2;
      break;
    default:
      return;
  }
  
  output(msg);
}

void HardReset() {
  /* Common */
  g_timerCounter = 0;
  
  
  /* BbWA_Status */
  g_bbwaStatus.isPrimary = 0;
  g_primaryEcu.actuator = ACTUATOR_0;
  g_bbwaStatus.state = NORMAL;
  g_bbwaStatus.msgCount = 0;
  
  
  /* BrakeFeedback */
  g_brakeFeedback.feedbackPressure = 0;
  g_brakeFeedback.wheelSpeed = 0;
  g_brakeFeedback.feedbackAbsActive = ABS_INACTIVE;
  g_brakeFeedback.errorSig = SIGNAL_SUCCESS;
  
  
  /* FailStatus */
  g_failStatus.failCount = 0;
  g_failStatus.failInfo = CAN_BUSY;
  g_malfunctionState = MALFUNCTION_NONFAULT;
}

void ActuateBrake() {
  //todo!: involving ABS while braking
  
  if (g_malfunctionState == MALFUNCTION_LOGIC_ERR) {
    g_failStatus.failCount++;
    g_failStatus.failInfo = ACTUATOR_ERR;
  }
  
  if (ACTUATOR_NUM != g_primaryEcu.actuator) {
    return;
  }
  
  MechanicalBrake();
}


void MechanicalBrake() {
  double vehicleSpeed_cmp10ms, targetSpeed_cmp10ms, speedDelta;
  double Fb, a;
  vehicleSpeed_cmp10ms = g_powertrainStatus.vehicleSpeed * KPH_TO_CMP10MS;
  targetSpeed_cmp10ms = g_powertrainStatus.targetSpeed * KPH_TO_CMP10MS;
  speedDelta = vehicleSpeed_cmp10ms - targetSpeed_cmp10ms;
  
  if (speedDelta <= 0) {
    g_speed_cmp10ms = targetSpeed_cmp10ms;
  }
  else {
    g_speed_cmp10ms = vehicleSpeed_cmp10ms - g_brakeCommand.activeBrakePressure * SPEED_DELTA_PER_BAR_CMP10MS;
    if (g_speed_cmp10ms < targetSpeed_cmp10ms) {
      g_speed_cmp10ms = targetSpeed_cmp10ms;
    }
  }
  CalculateWheelSpeed();
  // write("wheelspeed: %d, speed: %lf", g_brakeFeedback.wheelSpeed, g_speed_cmp10ms / KPH_TO_CMP10MS);
}

void CalculateWheelSpeed() {
  g_brakeFeedback.wheelSpeed = (g_speed_cmp10ms * SECOND_TO_10MS * MINUITE_TO_SECOND) / (2 * pi * TYRE_RADIUS_CM);
}

on message 0x000 {
  if (g_bbwaStatus.primaryBus == BOTH) {
    g_bbwaStatus.primaryBus = (this.can == 1) ? CAN_2 : CAN_1;
  }
  else if (g_bbwaStatus.primaryBus != this.can) {
    return;
  }
  else {
    g_bbwaStatus.primaryBus = NEITHER;
    ModifyMachineStatus(EMERGENCY);
  }
}

on key 'g' {
  g_malfunctionState = MALFUNCTION_TRANSCEIVER_ERR;
  //setTimer(g_resetTimer, 3000);
}
