/*@!Encoding:65001*/
includes
{
  
}

variables
{
  /* Timer */
  msTimer message_timer_10ms; // 주기 메시지를 위한 타이머
  int timer_cnt = 0;          // 타이머 카운터
  int alive_cnt = 0;          // ECU 상태 확인용 카운터
  
  char alive_flag;            // ECU 상태 확인용 flag 변수
}

void alive_check()
{ 
  if(alive_flag == 0x7)     // 전부 정상 확인
  {
    // 상태 확인 초기화
    alive_cnt = 0;
    alive_flag = 0;
  }
}

/* VCU(Tx) -> Other ECU(Rx) */
void output_100ms()
{
  // 0x251
  message PcanHealthyCheck msg;
  output(msg);
}

// Tx Cyclic message
on timer message_timer_10ms
{
  timer_cnt++;
  alive_cnt++;
  
  if(alive_cnt >= 30)       // 300ms 지남
  {
    // 0x201
    message PcanModeStatus msg;
    msg.Mode_Status = 2;
    output(msg);
  }
  
  if(timer_cnt % 10 == 0) {output_100ms();}
}

/* Initialize */
on preStart
{
  
}

on start
{
  setTimerCyclic(message_timer_10ms, 10);
}

/* PCAN */
/* BMU */
// 0x253
on message Pcan::BMUAlive
{
  alive_flag |= (this.BMU_Alive_Flag) << 0; // 0번째 비트 : BMU
  alive_check();
}

/* AHB */
// 0x254
on message PCAN::AHBAlive
{
  alive_flag |= (this.AHB_Alive_Flag) << 1; // 1번째 비트 : BMU
  alive_check();
}

/* MCU */
// 0x255
on message PCAN::MCUAlive
{
  alive_flag |= (this.MCU_Alive_Flag) << 2; // 2번째 비트 : MCU
  alive_check();
}
