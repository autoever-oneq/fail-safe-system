/*@!Encoding:65001*/

includes
{
  
}

variables
{
  msTimer message_timer_10ms; // 주기 메시지를 위한 타이머
  int timer_cnt;              // 타이머 카운터
  
  int emergency_cnt;          // 긴급모드 유지 시간 확인용 카운터
  char visit_emergency;       // 긴급모드 visit flag
  
  char image_direction;       // 애니메이션 내 이미지 프레임 변화 방향 (-1, 0, 1)
  
  const int battery_capacity = 100; // 배터리 최대 용량
  const int energy_efficiency = 5;  // 전비
  
  int battery_volt;       // 배터리 전압 (0 ~ 1000)
  int battery_soh;        // 배터리 잔존 수명 (0 ~ 100)
  int battery_soc;        // 배터리 충전량 (0 ~ 100)
  int battery_temp;       // 배터리 온도 (-50 ~ 150)
  
  // ECU 정상 상태 flag (0, 1)
  enum Alive_Flag {BAD, OK};
  enum Alive_Flag alive_flag;
  
  // 배터리 냉각 & 히터 시스템 flag (0 : 작동 x, 1 : 냉각 on, 2 : 히터 on)
  enum Battery_Hvac {NONE, COOLING, HEATING};
  enum Battery_Hvac battery_hvac;
  
  // 주행 상태 flag (0 : 일반, 1 : 주의, 2 : 긴급)
  enum Mode_Status {NORMAL, WARNING, EMERGENCY};
  enum Mode_Status mode_status;
  
  // 배터리 상태(온도, SOC)에 따른 MCU 출력 제한 flag (0 : 평시 상태, 1 : 출력 제한 상태)
  enum Output_Limit {NORMAL_BAT, WARNING_BAT};
  enum Output_Limit output_limit;
}

/* Initialize */
on preStart
{
  timer_cnt = 0;
  
  emergency_cnt = 0;
  visit_emergency = 0;
  
  battery_volt = 700;
  battery_soh = 100;
  battery_soc = 10000; // / 100(%)
  battery_temp = 30;
  
  alive_flag = OK;
  battery_hvac = NONE;
  mode_status = NORMAL;
  output_limit = NORMAL_BAT;
  
  image_direction = 0;
}

on start
{
  setTimerCyclic(message_timer_10ms, 10);
}

/* BMU(Tx) -> VCU(Rx) */
// 0x211
void BatteryMonitoring1_func()
{
  message BatteryMonitoring1 msg;
  
  msg.Battery_SOC = battery_soc / 100;
  
  if(emergency_cnt < 1000)
    output(msg);
}

// 0x236
void BatteryMonitoring0_func()
{
  message BatteryMonitoring0 msg;
  
  msg.Battery_Volt.phys = battery_volt;
  msg.Battery_SOH.phys = battery_soh;
  msg.Battery_Temp.phys = battery_temp;
  msg.Output_Limit.phys = output_limit;
  
  if(emergency_cnt < 1000)
    output(msg);
}

// 0x272
void RemainingRangeCal_func()
{
  message RemainingRangeCal msg;
  int remain_range;
  
  remain_range = battery_capacity * battery_soc * 5 / 10000;
  msg.Remain_Range.phys = remain_range;
  
  if(emergency_cnt < 1000)
    output(msg);
}

// 20ms func
void output_20ms()
{
  BatteryMonitoring0_func();  // 0x211
  BatteryMonitoring1_func();  // 0x236
  RemainingRangeCal_func();   // 0x272
}

// 60ms func
void output_60ms()
{
  @sysvar::Powertrain::ImageCnt = (@sysvar::Powertrain::ImageCnt + image_direction) & 15;
}

// 200ms func
void output_200ms()
{
  // 배터리 온도를 200ms마다 확인
  battery_temp += (battery_hvac == HEATING) - (battery_hvac == COOLING);  // 1도씩 변화
  
  if(battery_temp < 20)
    battery_hvac = HEATING;
  else if(battery_temp > 40)
    battery_hvac = COOLING;
  else
    battery_hvac = NONE;
}

// Tx Cyclic message
on timer message_timer_10ms
{
  ++timer_cnt;
  
  if(timer_cnt % 2 == 0) {output_20ms();}
  if(timer_cnt % 6 == 0) {output_60ms();}
  if(timer_cnt % 20 == 0) {output_200ms();}
  
  emergency_cnt = (mode_status == EMERGENCY) ? emergency_cnt + 1 : 0;
  if(emergency_cnt >= 1000)
    cancelTimer(message_timer_10ms);
}

/* VCU(Tx) -> BMU(Rx) */
// 0x201
on message PcanModeStatus
{
  switch($PcanModeStatus::Mode_Status)
  {
    case 0:
      mode_status = (visit_emergency == 0) ? NORMAL : WARNING;
      break;
    case 1:
      mode_status = WARNING;
      break;
    case 2:
      mode_status = EMERGENCY;
      visit_emergency = 1;
      break;
    default:
      mode_status = EMERGENCY;
      visit_emergency = 1;
  }
}

// 0x271
on message BatterySocUpdate
{
  int change;
  
  change = this.Battery_Soc_Change;
  battery_soc += change;
  image_direction = change > 0 ? -1 : change < 0 ? 1 : 0;
  
  // Outlier cut-off
  if(battery_soc < 0)
    battery_soc = 0;
  if(battery_soc > 10000)
    battery_soc = 10000;
  
  if(battery_temp <= 15 || battery_temp >= 45 || battery_soc <= 1000)
    output_limit = WARNING_BAT;
  else
    output_limit = NORMAL_BAT;
}

// 0x256
on message BatteryTempUpdate
{
  switch($BatteryTempUpdate::Battery_HVAC)
  {
    case 0:
      battery_hvac = NONE;
      break;
    case 1:
      battery_hvac = COOLING;
      break;
    case 2:
      battery_hvac = HEATING;
      break;
    default:
      battery_hvac = NONE;
  }
}

// 0x251
on message PcanHealthyCheck
{
  message BMUAlive alive;
  alive.BMU_Alive_Flag = alive_flag;
  
  if(emergency_cnt < 1000)
    output(alive);
}

/* End */
on preStop {}

on stopMeasurement {}

/* Test */
on key ','
{
  battery_temp = 0;
}

on key '.'
{
  battery_temp = 60;
}

on key '/'
{
  alive_flag = alive_flag == OK ? BAD : OK;
}
