/*@!Encoding:65001*/
includes
{
  
}

variables
{
  int DMode = 0;
}

on start{
  @sysvar::BODY::CAUTIONBUTTON = 0;
  @sysvar::BODY::BRAKEINPUT = 0;
  @sysvar::BODY::LEFTBUTTON = 0;
  @sysvar::BODY::RIGHTBUTTON = 0;
}

on key 'q'
{
  if (@sysvar::BODY::CAUTIONBUTTON == 0) {
    @sysvar::BODY::CAUTIONBUTTON = 1;
  }
  else if (@sysvar::BODY::CAUTIONBUTTON == 1) {
    @sysvar::BODY::CAUTIONBUTTON = 0;
  }
}

on key 'a'
{
  if (@sysvar::BODY::LEFTBUTTON == 0) {
    @sysvar::BODY::LEFTBUTTON = 1;
    @sysvar::BODY::RIGHTBUTTON = 0;
  }
  else if (@sysvar::BODY::LEFTBUTTON == 1) {
    @sysvar::BODY::LEFTBUTTON = 0;
  }
}

on key 'd'
{
  if (@sysvar::BODY::RIGHTBUTTON == 0) {
    @sysvar::BODY::LEFTBUTTON = 0;
    @sysvar::BODY::RIGHTBUTTON = 1;
  }
  else if (@sysvar::BODY::RIGHTBUTTON == 1) {
    @sysvar::BODY::RIGHTBUTTON = 0;
  } 
}

on key 's'
{
  @sysvar::BODY::FLTIREPRESSURE -= 100;
}

on key 'w'
{
  @sysvar::BODY::FLTIREPRESSURE += 100;
}

on key 'l'
{
  @sysvar::BODY::FLTIREPRESSURE = 200;
}

on key 'b'
{
  if (@sysvar::BODY::BRAKEINPUT == 0) {
    @sysvar::BODY::BRAKEINPUT = 1;
  }
  else if (@sysvar::BODY::BRAKEINPUT == 1) {
    @sysvar::BODY::BRAKEINPUT = 0;
  } 
}

on key 'z'
{
  message DriveMode msg;
  DMode++;
  if(DMode == 3){
    DMode = 0;
  }
  msg.DriveMode = DMode;
  output(msg);
}