/*@!Encoding:65001*/
includes
{
  
}

variables
{
  int DMode = 0;
}

on start{
  @sysvar::BODY::CAUTIONBUTTON = 0;
  @sysvar::BODY::BRAKEINPUT = 0;
  @sysvar::BODY::LEFTBUTTON = 0;
  @sysvar::BODY::RIGHTBUTTON = 0;
}

on key 'p'
{
  if (@sysvar::BODY::CAUTIONBUTTON == 0) {
    @sysvar::BODY::CAUTIONBUTTON = 1;
  }
  else if (@sysvar::BODY::CAUTIONBUTTON == 1) {
    @sysvar::BODY::CAUTIONBUTTON = 0;
  }
}

on key 'j'
{
  if (@sysvar::BODY::LEFTBUTTON == 0) {
    @sysvar::BODY::LEFTBUTTON = 1;
    @sysvar::BODY::RIGHTBUTTON = 0;
  }
  else if (@sysvar::BODY::LEFTBUTTON == 1) {
    @sysvar::BODY::LEFTBUTTON = 0;
  }
}

on key 'l'
{
  if (@sysvar::BODY::RIGHTBUTTON == 0) {
    @sysvar::BODY::LEFTBUTTON = 0;
    @sysvar::BODY::RIGHTBUTTON = 1;
  }
  else if (@sysvar::BODY::RIGHTBUTTON == 1) {
    @sysvar::BODY::RIGHTBUTTON = 0;
  } 
}

on key 'k'
{
  @sysvar::BODY::FLTIREPRESSURE -= 100;
}

on key 'i'
{
  @sysvar::BODY::FLTIREPRESSURE += 100;
}

on key 'm'
{
  @sysvar::BODY::FLTIREPRESSURE = 200;
}

on key 'h'
{
  if (@sysvar::BODY::BRAKEINPUT == 0) {
    @sysvar::BODY::BRAKEINPUT = 1;
  }
  else if (@sysvar::BODY::BRAKEINPUT == 1) {
    @sysvar::BODY::BRAKEINPUT = 0;
  } 
}

on key 'u'
{
  message DriveMode msg;
  DMode++;
  if(DMode == 3){
    DMode = 0;
  }
  msg.DriveMode = DMode;
  output(msg);
}