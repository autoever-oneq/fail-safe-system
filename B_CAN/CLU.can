/*@!Encoding:65001*/
includes
{
  
}

variables
{
    msTimer loop;
    int RegBrakeLevel = 0;
    int Ignition_Status = 0;
    int StartUpFlag = 0;
    int Gear_Status = 0; 
    enum {
      P = 0,
      R = 1,
      N = 2,
      D = 3
    }GearDisplay;

    const int STAGE_REGBR_INPUT = 4;
}

on start
{
  sendMsg_RegBrake_level(RegBrakeLevel);
  setTimerCyclic(loop,100);
}

on timer loop{
  sendMsg_HVACControl();
  sendMsg_ADSOperation();
}



on sysvar_update INPUT::REGENBUTTON
{
  if (StartUpFlag == 1){
    if (@sysvar::INPUT::REGENBUTTON == 1){
      RegBrakeLevel++;
      if(RegBrakeLevel == STAGE_REGBR_INPUT) {
        RegBrakeLevel = 0;
      }
    sendMsg_RegBrake_level(RegBrakeLevel);
    }
  }
}

on sysvar_update INPUT::CAUTIONBUTTON
{
  sendMsg_CautionTurnInput(@sysvar::INPUT::CAUTIONBUTTON);  
}

on sysvar_update INPUT::LEFTBUTTON
{
    sendMsg_LeftTurnInput(@sysvar::INPUT::LEFTBUTTON);  
}

on sysvar_update INPUT::RIGHTBUTTON{
    sendMsg_RightTurnInput(@sysvar::INPUT::RIGHTBUTTON); 
}

on sysvar_update INPUT::IGNITIONBUTTON
{
  if (@sysvar::INPUT::IGNITIONBUTTON == 1){
    if ((Gear_Status == P)||(Gear_Status == N)) {     
      if(Ignition_Status == 0) {
        Ignition_Status = 1;
        sendMsg_IgnitionOn();
      }
      else {
        Ignition_Status = 0;
        sendMsg_IgnitionOn();
      }
    }   
  }
}

on message StartUp
{
  StartUpFlag = this.StartUpSignal;
}

on message TirePressureAlert 
{
  @sysvar::HW::TIREALERT = this.TireAlertFlag;
}

on message GearInput
{
  Gear_Status = this.GearInput;
}

void sendMsg_RegBrake_level(int ButtonState) {
  message RegBrake_level msg;
  msg.RegBrake_Level.phys = RegBrakeLevel;
  if(StartUpFlag == 1) output(msg);
}

void sendMsg_CautionTurnInput(int ButtonState){
  message CautionTurnInput msg;
  msg.CautionTurnSignal.phys = ButtonState;
  if(StartUpFlag == 1) output(msg); 
}

void sendMsg_LeftTurnInput(int ButtonState){
  message LeftTurnInput msg;
  msg.LeftTurnInputSignal.phys = ButtonState;
  if(StartUpFlag == 1) output(msg);  
}

void sendMsg_RightTurnInput(int ButtonState){
  message RightTurnInput msg;
  msg.RightTurnInputSignal.phys = ButtonState;
  if(StartUpFlag == 1) output(msg);  
}

void sendMsg_IgnitionOn() {
  message IgnitionOn msg;
  msg.IgnitionFlag.phys = Ignition_Status;
  output(msg);
}

void sendMsg_HVACControl(){
  message HVACControl msg;
  msg.HVACOperation.phys = 0;
  msg.HVACHeatCool.phys = 0;
  msg.HVACTemp.phys = 18;
  msg.HVACStrength.phys = 2;
  msg.HVACMode.phys = 0;
  if(StartUpFlag == 1) output(msg);
}

void sendMsg_ADSOperation(){
  message ADSOperation msg;
  msg.ADSOperation = 0;
  if(StartUpFlag == 1) output(msg);
}