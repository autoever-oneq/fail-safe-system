/*@!Encoding:65001*/
includes
{
  
}

variables
{
  int DMode = 0;
}

on start{
  @sysvar::INPUT::CAUTIONBUTTON = 0;
  @sysvar::INPUT::BRAKEINPUT = 0;
  @sysvar::INPUT::LEFTBUTTON = 0;
  @sysvar::INPUT::RIGHTBUTTON = 0;
}

on key 'q'
{
  if (@sysvar::INPUT::CAUTIONBUTTON == 0) {
    @sysvar::INPUT::CAUTIONBUTTON = 1;
  }
  else if (@sysvar::INPUT::CAUTIONBUTTON == 1) {
    @sysvar::INPUT::CAUTIONBUTTON = 0;
  }
}

on key 'a'
{
  if (@sysvar::INPUT::LEFTBUTTON == 0) {
    @sysvar::INPUT::LEFTBUTTON = 1;
    @sysvar::INPUT::RIGHTBUTTON = 0;
  }
  else if (@sysvar::INPUT::LEFTBUTTON == 1) {
    @sysvar::INPUT::LEFTBUTTON = 0;
  }
}

on key 'd'
{
  if (@sysvar::INPUT::RIGHTBUTTON == 0) {
    @sysvar::INPUT::LEFTBUTTON = 0;
    @sysvar::INPUT::RIGHTBUTTON = 1;
  }
  else if (@sysvar::INPUT::RIGHTBUTTON == 1) {
    @sysvar::INPUT::RIGHTBUTTON = 0;
  } 
}

on key 'l'
{
  @sysvar::STATUS::FLTIREPRESSURE = 200;
}

on key 'b'
{
  if (@sysvar::INPUT::BRAKEINPUT == 0) {
    @sysvar::INPUT::BRAKEINPUT = 1;
  }
  else if (@sysvar::INPUT::BRAKEINPUT == 1) {
    @sysvar::INPUT::BRAKEINPUT = 0;
  } 
}

on key 'z'
{
  message DriveMode msg;
  DMode++;
  if(DMode == 3){
    DMode = 0;
  }
  msg.DriveMode = DMode;
  output(msg);
}